/dts-v1/;
/plugin/;
/ {
	    compatible = "allwinner,sun8i-h3";

        fragment@0 {
                target-path = "/";
                __overlay__ {
                    ethpwm {
                        compatible = "ethpwm_proto";
                        pwms = <&pwm 0 1000000 0>;
                        pinctrl-names = "default";
                        status = "okay";
                    };
                };
        };
};
